## Development/system/coding/app/Kconfig
```kconfig
mainmenu "DigitalStethoscope"

config PHYSICALINTERFACE_VOLUME_POTENTIOMETER_FITTED
	bool "Volume potentiometer J7 fitted"
	depends on ADC
	default y
	help
	  Read the volume potentiometer on GPIO1, ADC1 channel 0. Turn this off
	  only for a carrier without J7: L1_PHYSICALINTERFACE then does not read
	  the ADC and reports the volume as absent, because an unfitted wiper
	  floats and its readings mean nothing.

source "Kconfig.zephyr"
```

## Development/system/coding/bringup-zephyr/tests/ci_contract/testcase.yaml
```yaml
tests:
  stethoscope.ci_contract:
    tags:
      - stethoscope
      - ci
    platform_allow:
      - native_sim/native/64
    integration_platforms:
      - native_sim/native/64
    timeout: 10
```

## software/evaluation/firmware/Kconfig
```kconfig
mainmenu "Digital stethoscope evaluation"
source "Kconfig.zephyr"
menu "Stethoscope evaluation"
config STETHO_POT_MAX_MV
 int "Measured potentiometer full-scale millivolts"
 range 1000 3300
 default 3100
config STETHO_CAPTURE_SECONDS
 int "Volatile clip and fixture capacity in seconds"
 range 1 20
 default 5
config STETHO_NETWORK
 bool "Build optional Wi-Fi and verified TLS FHIR support"
 default n
 depends on WIFI && NET_SOCKETS_SOCKOPT_TLS
config STETHO_CA_FILE
 string "Absolute path to PEM root CA to embed (public certificate only)"
 default ""
 depends on STETHO_NETWORK
endmenu
```
