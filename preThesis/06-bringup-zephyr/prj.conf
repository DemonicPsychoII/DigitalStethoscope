## CMakeLists.txt
```
# CMakeLists.txt — Zephyr bring-up test for the digital stethoscope hardware
cmake_minimum_required(VERSION 3.20.0)

find_package(Zephyr REQUIRED HINTS $ENV{ZEPHYR_BASE})
project(stetho_bringup)

target_include_directories(app PRIVATE include)

# Build identity printed at boot. run_ci.py passes -DSTETHO_BUILD_ID; a plain west build
# reports "local". The cache entry is dropped once read, so reconfiguring the directory
# without the option falls back to "local" instead of keeping an earlier CI identity.
set(STETHO_BUILD_ID_VALUE "local")
if(DEFINED STETHO_BUILD_ID)
  set(STETHO_BUILD_ID_VALUE "${STETHO_BUILD_ID}")
  unset(STETHO_BUILD_ID CACHE)
endif()
if(NOT STETHO_BUILD_ID_VALUE MATCHES "^[A-Za-z0-9 ._:+/-]+$")
  message(FATAL_ERROR "STETHO_BUILD_ID allows only letters, digits, spaces and ._:+/-")
endif()
file(CONFIGURE OUTPUT "${CMAKE_CURRENT_BINARY_DIR}/stetho_build_id.h"
     CONTENT "#define STETHO_BUILD_ID \"@STETHO_BUILD_ID_VALUE@\"\n" @ONLY)
target_include_directories(app PRIVATE "${CMAKE_CURRENT_BINARY_DIR}")

target_sources(app PRIVATE
    src/main.c
    src/app_logic.c
    src/peripherals.c
    src/gpio_inputs.c
    src/analog_backlight.c
    src/display_touch.c
    src/audio_loopback.c
    src/status_reporting.c
    src/stetho_dsp.c
    src/stetho_control.c
    src/stetho_shell.c
    src/stetho_fhir.c
    src/stetho_network.c
    src/sd_storage.c
)

target_link_libraries(app PRIVATE m)
if(CONFIG_STETHO_NETWORK)
  set(STETHO_CA_HEADER "${CMAKE_CURRENT_BINARY_DIR}/stetho_ca.h")
  if(CONFIG_STETHO_CA_FILE)
    if(NOT EXISTS "${CONFIG_STETHO_CA_FILE}")
      message(FATAL_ERROR "STETHO_CA_FILE does not exist")
    endif()
    set_property(DIRECTORY APPEND PROPERTY CMAKE_CONFIGURE_DEPENDS "${CONFIG_STETHO_CA_FILE}")
    file(READ "${CONFIG_STETHO_CA_FILE}" CA_HEX HEX)
    string(REGEX REPLACE "(..)" "0x\\1," CA_BYTES "${CA_HEX}")
    file(WRITE "${STETHO_CA_HEADER}" "static const unsigned char stetho_ca[] = {${CA_BYTES}0};\n")
  else()
    file(WRITE "${STETHO_CA_HEADER}" "static const unsigned char stetho_ca[] = {0};\n")
  endif()
  target_include_directories(app PRIVATE "${CMAKE_CURRENT_BINARY_DIR}")
endif()
```

## prj.conf
```kconfig
# --- Subsystems ---
CONFIG_GPIO=y
CONFIG_ADC=y
CONFIG_I2S=y
CONFIG_DMA=y
CONFIG_SPI=y
CONFIG_MIPI_DBI=y
CONFIG_DISPLAY=y
CONFIG_INPUT=y
CONFIG_PWM=y

# --- Logging / console ---
# Deferred logging keeps console formatting off the audio and input paths.
CONFIG_LOG=y
CONFIG_LOG_MODE_DEFERRED=y
CONFIG_CONSOLE=y
CONFIG_SERIAL=y
CONFIG_UART_CONSOLE=y

# --- Runtime ---
CONFIG_MAIN_STACK_SIZE=8192
CONFIG_HEAP_MEM_POOL_SIZE=16384
CONFIG_THREAD_NAME=y

# Always-on stack safety and inspectability. qc.conf adds periodic reporting.
# ESP32-S3 Xtensa reports ARCH_HAS_STACK_PROTECTION=n in this Zephyr revision.
CONFIG_STACK_SENTINEL=y
CONFIG_THREAD_ANALYZER=y
CONFIG_THREAD_ANALYZER_USE_LOG=y
CONFIG_THREAD_STACK_INFO=y
CONFIG_INIT_STACKS=y

# --- XPT2046 resistive touch (verify symbol name for your Zephyr version) ---
CONFIG_INPUT_XPT2046=y
# Warnings here can saturate the 115200 console faster than it can drain.
CONFIG_INPUT_LOG_LEVEL_ERR=y

# N16R8: clips/fixtures in external RAM; DMA remains internal.
CONFIG_ESP_SPIRAM=y
CONFIG_SPIRAM_MODE_OCT=y
CONFIG_ESP_SPIRAM_MEMTEST=y
CONFIG_ESPTOOLPY_FLASHSIZE_16MB=y
CONFIG_FPU=y
# Preserve DSP registers when Wi-Fi/driver threads or interrupts preempt audio.
CONFIG_FPU_SHARING=y
CONFIG_PICOLIBC=y
CONFIG_SHELL=y
CONFIG_SHELL_STACK_SIZE=4096
CONFIG_SHELL_CMD_BUFF_SIZE=768
# Hold a complete fixture-upload command while the DSP runs.
CONFIG_SHELL_BACKEND_SERIAL_RX_RING_BUFFER_SIZE=1024
CONFIG_SHELL_ARGC_MAX=12
CONFIG_SHELL_HISTORY=n
CONFIG_LOG_BUFFER_SIZE=4096
CONFIG_LOG_PROCESS_THREAD_STACK_SIZE=2048

# --- SD card on the LCD module (shared SPI2, CS GPIO48) ---
CONFIG_DISK_ACCESS=y
CONFIG_FILE_SYSTEM=y
CONFIG_FAT_FILESYSTEM_ELM=y
# Cards above 32 GB ship exFAT-formatted.
CONFIG_FS_FATFS_EXFAT=y
# Never format a card just because it failed to mount; that would erase user data.
CONFIG_FS_FATFS_MOUNT_MKFS=n
# `fs ls /SD:`, `fs read`, `fs write` and a later `fs mount fat /SD:` for evaluation.
CONFIG_FILE_SYSTEM_SHELL=y
```

## src/main.c
```c
/* Main owns peripheral orchestration; audio, display and network have workers. */
#include "analog_backlight.h"
#include "app_logic.h"
#include "app_types.h"
#include "audio_loopback.h"
#include "display_touch.h"
#include "gpio_inputs.h"
#include "peripherals.h"
#include "status_reporting.h"
#include "stetho_build_id.h"
#include "stetho_control.h"
#include <errno.h>
#include <stdlib.h>
#include <zephyr/drivers/gpio.h>
#include <zephyr/kernel.h>
#include <zephyr/logging/log.h>
LOG_MODULE_REGISTER(bringup, LOG_LEVEL_INF);
#define INPUT_RESPONSE_REQUIREMENT_MS 35U
K_MSGQ_DEFINE(app_event_queue, sizeof(struct app_event), 16, 4);
struct app_context {
	struct peripheral_registry peripherals;
	struct runtime_state runtime;
	unsigned int adc_errors, pwm_errors, gpio_errors, latency_violations;
	uint32_t max_input_latency_ms;
};
static void disable_after_policy(struct app_context *c, enum component_id component,
                                 enum driver_operation operation, unsigned int failures, int error)
{
	if (app_driver_error_action(operation, failures) == DRIVER_ERROR_DISABLE_COMPONENT) {
		peripherals_disable(&c->peripherals, component, error);
		c->runtime.features = app_degraded_features(c->peripherals.components);
	}
}
static void sample_analog(struct app_context *c)
{
	struct stetho_settings settings;
	stetho_settings_get(&settings);
	if (peripherals_operational(&c->peripherals, COMP_POTENTIOMETER)) {
		int mv;
		int rc = analog_backlight_read_mv(&mv);
		if (rc)
			disable_after_policy(c, COMP_POTENTIOMETER, DRIVER_OP_ADC_SAMPLE,
			                     ++c->adc_errors, rc);
		else {
			c->adc_errors = 0;
			c->runtime.potentiometer_mv = mv;
			if (settings.pot && !settings.diagnostics) {
				unsigned int volume = (unsigned int)CLAMP(
				        mv * 100 / CONFIG_STETHO_POT_MAX_MV, 0, 100);
				/* Suppress ADC jitter; the audio worker ramps the accepted gain. */
				if (volume == 0 || volume == 100 ||
				    abs((int)volume - (int)settings.volume) >= 2)
					stetho_setting_set("volume", volume);
			}
		}
	}
	if (peripherals_operational(&c->peripherals, COMP_BACKLIGHT)) {
		int mv = settings.diagnostics && peripherals_operational(&c->peripherals,
		                                                         COMP_POTENTIOMETER)
		                 ? c->runtime.potentiometer_mv
		                 : (int)settings.brightness * APP_MAX_MILLIVOLTS / 100;
		int rc = analog_backlight_set_mv(mv);
		if (rc)
			disable_after_policy(c, COMP_BACKLIGHT, DRIVER_OP_BACKLIGHT_PWM,
			                     ++c->pwm_errors, rc);
		else
			c->pwm_errors = 0;
		c->runtime.brightness_percent = app_brightness_percent(mv);
	}
}
static void handle_event(struct app_context *c, const struct app_event *event)
{
	uint32_t latency = k_uptime_get_32() - event->timestamp_ms;
	c->max_input_latency_ms = MAX(c->max_input_latency_ms, latency);
	if (latency > INPUT_RESPONSE_REQUIREMENT_MS &&
	    app_should_log_failure(++c->latency_violations))
		LOG_WRN("Input handler latency %u ms", latency);
	struct stetho_settings settings;
	stetho_settings_get(&settings);
	switch (event->type) {
	case APP_EVENT_BUTTON:
		if (peripherals_operational(&c->peripherals, COMP_BUTTON_LED)) {
			bool previous = c->runtime.button_pressed;
			c->runtime.button_pressed = event->data.button_pressed;
			if (event->data.button_pressed && !previous) {
				if (settings.diagnostics)
					c->runtime.led_on = !c->runtime.led_on;
				else {
					struct audio_snapshot audio;
					audio_loopback_snapshot(&audio);
					stetho_action_request(audio.capturing || audio.replaying
					                              ? ACTION_LIVE
					                              : ACTION_CAPTURE);
					c->runtime.led_on = !(audio.capturing || audio.replaying);
				}
				int rc = gpio_inputs_set_led(c->runtime.led_on);
				if (rc)
					disable_after_policy(c, COMP_BUTTON_LED,
					                     DRIVER_OP_GPIO_OUTPUT,
					                     ++c->gpio_errors, rc);
				else
					c->gpio_errors = 0;
			}
		}
		break;
	case APP_EVENT_SWITCH:
		if (peripherals_operational(&c->peripherals, COMP_SWITCH)) {
			c->runtime.switch_position = event->data.switch_position;
			if (event->data.switch_position >= 1 && event->data.switch_position <= 3)
				stetho_setting_set("filter", event->data.switch_position - 1);
			peripherals_note_physical(&c->peripherals, COMP_SWITCH);
		}
		break;
	case APP_EVENT_SPEED:
		if (event->data.switch_position >= 1 && event->data.switch_position <= 3)
			stetho_setting_set("speed", event->data.switch_position == 1   ? 100
			                            : event->data.switch_position == 2 ? 75
			                                                               : 50);
		break;
	case APP_EVENT_TOUCH:
		if (peripherals_operational(&c->peripherals, COMP_TOUCH) &&
		    app_touch_transition(&c->runtime.touch, event->timestamp_ms,
		                         event->data.touch.x, event->data.touch.y,
		                         (uint8_t)display_touch_color_count())) {
			peripherals_note_physical(&c->peripherals, COMP_TOUCH);
			if (settings.diagnostics) {
				int rc = display_touch_show_color(c->runtime.touch.color_index);
				if (rc)
					LOG_WRN("Color request failed: %d", rc);
			} else
				stetho_control_touch(event->data.touch.x, event->data.touch.y);
		}
		break;
	default:
		break;
	}
}
static void start_available_features(struct app_context *c)
{
	gpio_inputs_get_initial(&c->runtime.button_pressed, &c->runtime.switch_position);
	if (c->runtime.switch_position >= 1 && c->runtime.switch_position <= 3)
		stetho_setting_set("filter", c->runtime.switch_position - 1);
	if (peripherals_operational(&c->peripherals, COMP_BUTTON_LED)) {
		int rc = gpio_inputs_start_button(GPIO_INT_EDGE_BOTH);
		if (rc)
			peripherals_disable(&c->peripherals, COMP_BUTTON_LED, rc);
	}
	if (peripherals_operational(&c->peripherals, COMP_SWITCH)) {
		int rc = gpio_inputs_start_switch(GPIO_INT_EDGE_BOTH);
		if (rc)
			peripherals_disable(&c->peripherals, COMP_SWITCH, rc);
	}
	int rc = gpio_inputs_start_speed();
	if (rc)
		LOG_WRN("Optional speed switch disabled: %d", rc);
	c->runtime.features = app_degraded_features(c->peripherals.components);
	/* DAC test sources remain usable even if the microphone probe fails. */
	if (peripherals_operational(&c->peripherals, COMP_DAC)) {
		rc = audio_loopback_start();
		if (rc)
			LOG_ERR("Audio start failed: %d", rc);
	}
}
int main(void)
{
	struct app_context c = {0};
	struct app_event event;
	/* First console output after Zephyr's banner, so a flashed board names its build. */
	printk("Digital Stethoscope firmware %s\n", STETHO_BUILD_ID);
	LOG_INF("=== Stethoscope integrated evaluation ===");
	peripherals_probe_all(&c.peripherals);
	peripherals_report(&c.peripherals);
	start_available_features(&c);
	uint32_t next_analog = 0, next_status = 0;
	while (true) {
		int rc = k_msgq_get(&app_event_queue, &event, K_MSEC(5));
		if (!rc)
			handle_event(&c, &event);
		else if (rc != -EAGAIN)
			LOG_ERR("Event receive: %d", rc);
		uint32_t now = k_uptime_get_32();
		if ((int32_t)(now - next_analog) >= 0) {
			sample_analog(&c);
			next_analog = now + 100;
		}
		if ((int32_t)(now - next_status) >= 0) {
			status_reporting_log(&c.peripherals, &c.runtime);
			LOG_INF("input-latency-max=%ums requirement<=%ums", c.max_input_latency_ms,
			        INPUT_RESPONSE_REQUIREMENT_MS);
			struct stetho_settings settings;
			stetho_settings_get(&settings);
			if (!settings.diagnostics &&
			    peripherals_operational(&c.peripherals, COMP_BUTTON_LED)) {
				struct audio_snapshot audio;
				audio_loopback_snapshot(&audio);
				c.runtime.led_on = audio.capturing || audio.replaying;
				rc = gpio_inputs_set_led(c.runtime.led_on);
				if (rc)
					disable_after_policy(&c, COMP_BUTTON_LED,
					                     DRIVER_OP_GPIO_OUTPUT, ++c.gpio_errors,
					                     rc);
				else
					c.gpio_errors = 0;
			}
			next_status = now + 2000;
		}
	}
	return 0;
}
```

## include/app_events.h
```c
#ifndef STETHO_APP_EVENTS_H
#define STETHO_APP_EVENTS_H

#include <zephyr/kernel.h>

/* Defined by main.c. Callbacks only enqueue; main is the sole consumer. */
extern struct k_msgq app_event_queue;

#endif
```

## include/display_touch.h
```c
#ifndef STETHO_DISPLAY_TOUCH_H
#define STETHO_DISPLAY_TOUCH_H

#include <stddef.h>
#include <stdint.h>

void display_touch_stats(uint32_t *errors, uint32_t *drops, uint32_t *max_ms);
int display_touch_probe_display(void);
int display_touch_probe_touch(void);
int display_touch_show_color(uint8_t color_index);
size_t display_touch_color_count(void);
const char *display_touch_color_name(uint8_t color_index);

#endif
```

## include/stetho_fhir.h
```c
#ifndef STETHO_FHIR_H
#define STETHO_FHIR_H
#include <stdbool.h>
#include <stddef.h>
#include <stdint.h>
bool stetho_fhir_id_valid(const char *value);
int stetho_fhir_json(char *buffer, size_t capacity, const char *patient, const char *id,
                     const char *timestamp, uint32_t bpm_tenths);
int stetho_network_configure(const char *host, unsigned int port, const char *base,
                             const char *patient);
int stetho_network_token(const char *token);
int stetho_network_send(void);
int stetho_network_time(int64_t epoch);
int stetho_network_sync(const char *host);
void stetho_network_status(int *result, bool *configured, bool *busy);
#endif
```

## src/peripherals.c
```c
#include "peripherals.h"

#include <errno.h>

#include <zephyr/kernel.h>
#include <zephyr/logging/log.h>
#include <zephyr/sys/util.h>

#include "analog_backlight.h"
#include "app_logic.h"
#include "audio_loopback.h"
#include "display_touch.h"
#include "gpio_inputs.h"
#include "sd_storage.h"

LOG_MODULE_REGISTER(peripherals, LOG_LEVEL_INF);

#define PROBE_RETRY_MS 50

struct component_definition {
	const char *name;
	const char *hint;
	int (*probe)(void);
	enum presence_evidence success_evidence;
};

static const struct component_definition definitions[COMP_COUNT] = {
        [COMP_BUTTON_LED] =
                {
                        "pushbutton + LED (GPIO16/17)",
                        "controller/pin configuration failed",
                        gpio_inputs_probe_button_led,
                        PRESENCE_CONTROLLER_READY,
                },
        [COMP_SWITCH] =
                {
                        "SP3T switch (GPIO18/21/38)",
                        "common pole to GND; exactly one throw active",
                        gpio_inputs_probe_switch,
                        PRESENCE_PHYSICAL_VERIFIED,
                },
        [COMP_POTENTIOMETER] =
                {
                        "potentiometer (GPIO1, ADC1_CH0)",
                        "ADC conversion or wiring failed",
                        analog_backlight_probe_potentiometer,
                        PRESENCE_TRANSFER_ACCEPTED,
                },
        [COMP_BACKLIGHT] =
                {
                        "backlight PWM (GPIO8, LEDC ch0)",
                        "LEDC controller/duty setup failed",
                        analog_backlight_probe_pwm,
                        PRESENCE_CONTROLLER_READY,
                },
        [COMP_DISPLAY] =
                {
                        "display ILI9341 (SPI2, CS GPIO10)",
                        "driver/geometry/blanking command failed",
                        display_touch_probe_display,
                        PRESENCE_TRANSFER_ACCEPTED,
                },
        [COMP_TOUCH] =
                {
                        "touch XPT2046 (SPI2, CS GPIO7)",
                        "driver not ready; no touch response proven",
                        display_touch_probe_touch,
                        PRESENCE_CONTROLLER_READY,
                },
        [COMP_MICROPHONE] =
                {
                        "mic INMP441 (I2S0)",
                        "check BCLK/WS/SD, power and L/R",
                        audio_loopback_probe_microphone,
                        PRESENCE_PHYSICAL_VERIFIED,
                },
        [COMP_DAC] =
                {
                        "DAC PCM5102A (I2S1)",
                        "TX accepted only; acoustic output still unverified",
                        audio_loopback_probe_dac,
                        PRESENCE_TRANSFER_ACCEPTED,
                },
        [COMP_SD_CARD] =
                {
                        "SD card (SPI2, CS GPIO48)",
                        "insert a FAT/exFAT card before boot or use 'fs mount fat /SD:'",
                        sd_storage_probe,
                        PRESENCE_PHYSICAL_VERIFIED,
                },
};

const char *peripherals_component_name(enum component_id component)
{
	return component < COMP_COUNT ? definitions[component].name : "unknown";
}

const char *peripherals_evidence_name(enum presence_evidence evidence)
{
	switch (evidence) {
	case PRESENCE_CONTROLLER_READY:
		return "controller-ready";
	case PRESENCE_TRANSFER_ACCEPTED:
		return "transfer-accepted";
	case PRESENCE_PHYSICAL_VERIFIED:
		return "physical-response";
	default:
		return "not-ready";
	}
}

static enum presence_evidence failure_evidence(enum component_id component, int error)
{
	if (component == COMP_SWITCH && error == -ENODATA) {
		return PRESENCE_CONTROLLER_READY;
	}
	if (component == COMP_MICROPHONE && error == -ENODATA) {
		return PRESENCE_TRANSFER_ACCEPTED;
	}
	return PRESENCE_NOT_READY;
}

size_t peripherals_probe_all(struct peripheral_registry *registry)
{
	size_t operational_count = 0U;

	for (enum component_id id = 0; id < COMP_COUNT; id++) {
		struct app_probe_state probe = {0};
		int rc;

		do {
			rc = definitions[id].probe();
			if (app_probe_record(&probe, rc, PERIPHERAL_MAX_ATTEMPTS)) {
				k_msleep(PROBE_RETRY_MS);
			}
		} while (!probe.done);

		registry->components[id] = (struct component_status){
		        .operational = probe.success,
		        .evidence = probe.success ? definitions[id].success_evidence
		                                  : failure_evidence(id, probe.last_error),
		        .error = probe.last_error,
		        .attempts = probe.attempts,
		};
		if (probe.success) {
			operational_count++;
		}
	}
	return operational_count;
}

void peripherals_report(const struct peripheral_registry *registry)
{
	size_t usable = 0U;

	for (enum component_id id = 0; id < COMP_COUNT; id++) {
		usable += registry->components[id].operational ? 1U : 0U;
	}
	LOG_INF("---- peripheral probe: %u of %u operational (max %u attempts each) ----",
	        (unsigned int)usable, COMP_COUNT, PERIPHERAL_MAX_ATTEMPTS);
	for (enum component_id id = 0; id < COMP_COUNT; id++) {
		const struct component_status *status = &registry->components[id];

		if (status->operational) {
			LOG_INF("[ OK ] %s (%s, attempt %u)", definitions[id].name,
			        peripherals_evidence_name(status->evidence), status->attempts);
		} else {
			LOG_WRN("[ -- ] %s (%s, err %d after %u attempts) - %s",
			        definitions[id].name, peripherals_evidence_name(status->evidence),
			        status->error, status->attempts, definitions[id].hint);
		}
	}
	LOG_INF("Evidence labels describe firmware knowledge, not blanket physical presence");
}

bool peripherals_operational(const struct peripheral_registry *registry,
                             enum component_id component)
{
	return component < COMP_COUNT && registry->components[component].operational;
}

void peripherals_disable(struct peripheral_registry *registry, enum component_id component,
                         int error)
{
	if (component >= COMP_COUNT) {
		return;
	}
	registry->components[component].operational = false;
	registry->components[component].error = error;
	LOG_ERR("component disabled: %s (err %d)", definitions[component].name, error);
}

void peripherals_note_physical(struct peripheral_registry *registry, enum component_id component)
{
	if (component < COMP_COUNT && registry->components[component].operational) {
		registry->components[component].evidence = PRESENCE_PHYSICAL_VERIFIED;
	}
}
```
